## WICED/RTOS/NuttX/ver7.8/arch/arm/src/armv7-r/Kconfig
```kconfig
#
# For a description of the syntax of this configuration file,
# see misc/tools/kconfig-language.txt.
#

comment "ARMv7-R Configuration Options"

config ARMV7R_TOOLCHAIN_WICED
	bool "WICED toolchain"
	default y
	depends on ARCH_CHIP_BCM4390X
```

## WICED/RTOS/NuttX/ver7.8/arch/arm/src/bcm4390x/Kconfig
```kconfig
#
# Broadcom Proprietary and Confidential. Copyright 2016 Broadcom
# All Rights Reserved.
#
# This is UNPUBLISHED PROPRIETARY SOURCE CODE of Broadcom Corporation;
# the contents of this file may not be disclosed to third parties, copied
# or duplicated in any form, in whole or in part, without the prior
# written permission of Broadcom Corporation.
#
#
# For a description of the syntax of this configuration file,
# see misc/tools/kconfig-language.txt.
#

if ARCH_CHIP_BCM4390X

comment "BCM4390X Configuration Options"

config BCM4390X_UART0
	bool "UART0"
	default y
	select ARCH_HAVE_UART0

config BCM4390X_UART1
	bool "UART1"
	default y
	select ARCH_HAVE_UART1

config BCM4390X_SPI1
	bool "SPI1"
	default n
	select SPI
	select SPI_EXCHANGE
	---help---
		Support SPI1

config BCM4390X_SPI2
	bool "SPI2"
	default n
	select SPI
	select SPI_EXCHANGE
	---help---
		Support SPI2

config BCM4390X_WWD
	bool "WWD"
	default y
	depends on NET
	select ARCH_HAVE_PHY
	select ARCH_PHY_INTERRUPT

endif # ARCH_CHIP_BCM4390X
```
